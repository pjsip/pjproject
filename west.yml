## zephyr/samples/simple_pjsua/sample.yaml
```yaml
sample:
  name: PJSIP simple_pjsua
  description: pjsua-lib user agent registering to a PBX and taking calls
tests:
  sample.pjsip.simple_pjsua:
    build_only: true
    platform_allow:
      - mps2/an521/cpu0
      - native_sim/native/64
    tags: net pjsip
```

## zephyr/tests/pjlib-util/testcase.yaml
```yaml
# native_sim runs under twister; the AN521 is build-only, as for tests/pjlib.
common:
  tags: pjsip
tests:
  pjsip.pjlib-util:
    platform_allow:
      - native_sim/native/64
    harness: console
    harness_config:
      type: one_line
      regex:
        - "Looks like everything is okay"
    timeout: 1200
  pjsip.pjlib-util.threads:
    platform_allow:
      - native_sim/native/64
    extra_args: EXTRA_CONF_FILE=../overlay-threads.conf
    harness: console
    harness_config:
      type: one_line
      regex:
        - "Looks like everything is okay"
    timeout: 1200
  pjsip.pjlib-util.an521:
    platform_allow:
      - mps2/an521/cpu0
    build_only: true
```

## zephyr/tests/pjnath/testcase.yaml
```yaml
# native_sim runs under twister; the AN521 is build-only, as for tests/pjlib.
common:
  tags: pjsip
tests:
  pjsip.pjnath:
    platform_allow:
      - native_sim/native/64
    harness: console
    harness_config:
      type: one_line
      regex:
        - "Looks like everything is okay"
    timeout: 1200
  pjsip.pjnath.threads:
    platform_allow:
      - native_sim/native/64
    extra_args: EXTRA_CONF_FILE=../overlay-threads.conf
    harness: console
    harness_config:
      type: one_line
      regex:
        - "Looks like everything is okay"
    timeout: 1200
  pjsip.pjnath.an521:
    platform_allow:
      - mps2/an521/cpu0
    build_only: true
```

## zephyr/tests/pjsip/boards/native_sim_native_64.conf
```kconfig
# Host memory is plentiful
CONFIG_COMMON_LIBC_MALLOC_ARENA_SIZE=8388608
CONFIG_HEAP_MEM_POOL_SIZE=1048576
```
